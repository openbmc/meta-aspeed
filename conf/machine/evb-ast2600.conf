## conf/machine/evb-ast2600.conf
```bitbake
KMACHINE = "aspeed"
KERNEL_DEVICETREE = "${KMACHINE}-ast2600-evb.dtb"

UBOOT_MACHINE = "ast_g6_phy_config"

FLASH_SIZE = "32768"

require conf/machine/include/ast2600.inc
```

## conf/machine/include/aspeed.inc
```bitbake
PREFERRED_PROVIDER_virtual/kernel ?= "linux-aspeed"
PREFERRED_PROVIDER_virtual/bootloader ?= "u-boot-aspeed"
PREFERRED_PROVIDER_u-boot ?= "u-boot-aspeed"
PREFERRED_PROVIDER_u-boot-fw-utils ?= "u-boot-fw-utils-aspeed"

# Build a FIT image and stuff core-image-minimal in it by default.
KERNEL_IMAGETYPE ?= "fitImage"
KERNEL_CLASSES ?= "kernel-fitimage"
INITRAMFS_IMAGE ?= "core-image-minimal"

MACHINEOVERRIDES =. "aspeed:"
```

## conf/machine/include/ast2600.inc
```bitbake
SOC_FAMILY = "aspeed-g6"
include conf/machine/include/soc-family.inc
include conf/machine/include/arm/arch-armv7a.inc
require conf/machine/include/aspeed.inc

UBOOT_ENTRYPOINT = "0x80001000"
UBOOT_LOADADDRESS = "0x80001000"
```
